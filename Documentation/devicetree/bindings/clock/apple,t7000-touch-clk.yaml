## Documentation/devicetree/bindings/sound/apple,t7000-mca.yaml
```yaml
# SPDX-License-Identifier: (GPL-2.0-only OR BSD-2-Clause)
%YAML 1.2
---
$id: http://devicetree.org/schemas/sound/apple,t7000-mca.yaml#
$schema: http://devicetree.org/meta-schemas/core.yaml#

title: Apple A8 MCA I2S/TDM controller

maintainers:
  - ITSMEFRTRUST <215584995+ITSMEFRTRUST@users.noreply.github.com>

description: |
  One serial audio port of the "version 1" Multi-Channel Audio (MCA) block
  on the Apple A8 SoC. Samples reach the MCA through a small SRAM FIFO
  ("shim") that iOS fills from the SmartIO coprocessor and that the CPU can
  fill directly. The shim control registers and the I2S pin switch sit in
  wrapper pages shared by all MCA instances.

allOf:
  - $ref: dai-common.yaml#

properties:
  compatible:
    const: apple,t7000-mca

  reg:
    items:
      - description: MCA core, its shims and their FIFO ports
      - description: shared audio wrapper (shim control, MCLK pads, I2S switch)
      - description: shared second shim wrapper

  reg-names:
    items:
      - const: mca
      - const: wrapper
      - const: shim1

  interrupts:
    maxItems: 1

  clocks:
    maxItems: 1
    description: NCO channel that clocks the frame generator

  power-domains:
    maxItems: 1

  apple,i2s-pin:
    $ref: /schemas/types.yaml#/definitions/uint32
    maximum: 16
    description:
      I2S switch pin group the port is routed to. Defaults to the MCA index.

  apple,shim-sram-offset:
    $ref: /schemas/types.yaml#/definitions/uint32
    maximum: 0x3fc
    multipleOf: 4
    default: 0
    description:
      Byte offset of this MCA's FIFOs in the TX and RX shim SRAM pools
      (0x400 bytes each), so that MCAs running at once do not overlap.

  '#sound-dai-cells':
    enum: [0, 1]
    description:
      With 1 cell, DAI 0 is the playback-only DAI and DAI 1 a second DAI
      with playback and capture, for a second codec on the same bus. Both
      share the one TX slot.

  '#clock-cells':
    const: 1
    description:
      The node provides the MCLK pads of all MCA instances (index 0-4) as
      12 MHz clocks, for a codec clocked from the pad of an unused MCA.

required:
  - compatible
  - reg
  - reg-names
  - clocks
  - power-domains
  - '#sound-dai-cells'

unevaluatedProperties: false

examples:
  - |
    #include <dt-bindings/interrupt-controller/apple-aic.h>
    #include <dt-bindings/interrupt-controller/irq.h>

    soc {
        #address-cells = <2>;
        #size-cells = <2>;

        i2s@20a0a8000 {
            compatible = "apple,t7000-mca";
            reg = <0x2 0x0a0a8000 0x0 0x4000>,
                  <0x2 0x0a000000 0x0 0x4000>,
                  <0x2 0x0a100000 0x0 0x1000>;
            reg-names = "mca", "wrapper", "shim1";
            interrupts = <AIC_IRQ 171 IRQ_TYPE_LEVEL_HIGH>;
            clocks = <&nco 2>;
            power-domains = <&ps_mca2>;
            #sound-dai-cells = <1>;
            #clock-cells = <1>;
        };
    };
```

## Documentation/devicetree/bindings/sound/cirrus,cs35l33.yaml
```yaml
# SPDX-License-Identifier: (GPL-2.0-only OR BSD-2-Clause)
%YAML 1.2
---
$id: http://devicetree.org/schemas/sound/cirrus,cs35l33.yaml#
$schema: http://devicetree.org/meta-schemas/core.yaml#

title: Cirrus Logic CS35L33 / CS35L19 Speaker Amplifier

maintainers:
  - David Rhodes <david.rhodes@cirrus.com>
  - patches@opensource.cirrus.com

description:
  CS35L33 and CS35L19 are boosted mono Class D amplifiers with an internal
  Class H/G algorithm that controls the amplifier supplies.

allOf:
  - $ref: dai-common.yaml#
  - if:
      properties:
        compatible:
          contains:
            const: cirrus,cs35l33
    then:
      properties:
        cirrus,boost-slew-step: false
        cirrus,boost-coeffs: false
        cirrus,trim: false

properties:
  compatible:
    enum:
      - cirrus,cs35l33
      - cirrus,cs35l19

  reg:
    maxItems: 1

  '#sound-dai-cells':
    const: 0

  VA-supply:
    description: Voltage regulator of the analog internal section

  VP-supply:
    description: Voltage regulator of the boost converter

  reset-gpios:
    maxItems: 1

  interrupts:
    maxItems: 1

  cirrus,boost-ctl:
    description:
      Booster voltage used to supply the amplifier. If the value is 0, then
      VBST = VP. If greater than 0, the boost voltage will be 3300mV with a
      value of 1 and will increase at a step size of 100mV until a maximum of
      8000mV.
    $ref: /schemas/types.yaml#/definitions/uint32
    minimum: 0
    maximum: 0x30

  cirrus,ramp-rate:
    description:
      On power up, it affects the time from when the power up sequence begins
      to the time the audio reaches a full-scale output. On power down, it
      affects the time from when the power-down sequence begins to when the
      amplifier disables the PWM outputs. If this property is not set then
      soft ramping will be disabled and ramp time would be 20ms. If this
      property is set to 0,1,2,3 then ramp times would be 40ms, 60ms, 100ms,
      175ms respectively for 48KHz sample rate.
    $ref: /schemas/types.yaml#/definitions/uint32
    minimum: 0
    maximum: 3

  cirrus,boost-ipk:
    description:
      The maximum current allowed for the boost converter, in uA. The range
      starts at 1850000uA and goes to a maximum of 3600000uA with a step size
      of 15625uA.
    $ref: /schemas/types.yaml#/definitions/uint32
    minimum: 1850000
    maximum: 3600000
    default: 2500000

  cirrus,imon-adc-scale:
    description:
      Configures the scaling of data bits from the IMON ADC data word. This
      property can be set as a value of 0 for bits 15 down to 0, 6 for 21 down
      to 6, 7 for 22 down to 7, 8 for 23 down to 8.
    $ref: /schemas/types.yaml#/definitions/uint32
    enum: [0, 6, 7, 8]

  cirrus,boost-slew-step:
    description: Boost converter VBST slew step. CS35L19 only.
    $ref: /schemas/types.yaml#/definitions/uint32
    minimum: 0
    maximum: 3

  cirrus,boost-coeffs:
    description:
      Four bytes for the boost loop coefficient registers 0x3A to 0x3D.
      CS35L19 only.
    $ref: /schemas/types.yaml#/definitions/uint8-array
    minItems: 4
    maxItems: 4

  cirrus,trim:
    description:
      Three bytes of board specific trim, written to the registers 0x46, 0x54
      and 0x66. CS35L19 only.
    $ref: /schemas/types.yaml#/definitions/uint8-array
    minItems: 3
    maxItems: 3

  cirrus,hg-algo:
    description:
      Sub-node enabling the internal Class H/G algorithm that controls the
      amplifier supplies.
    $ref: '#/$defs/hg-algo'

required:
  - compatible
  - reg
  - VA-supply
  - VP-supply

unevaluatedProperties: false

$defs:
  hg-algo:
    type: object
    additionalProperties: false

    properties:
      cirrus,mem-depth:
        description:
          Memory depth for the Class H/G algorithm measured in LRCLK cycles.
          If this property is set to 0, 1, 2, or 3 then the memory depths will
          be 1, 4, 8, 16 LRCLK cycles. The default is 16 LRCLK cycles.
        $ref: /schemas/types.yaml#/definitions/uint32
        minimum: 0
        maximum: 3

      cirrus,release-rate:
        description:
          The number of consecutive LRCLK periods before allowing release
          condition tracking updates.
        $ref: /schemas/types.yaml#/definitions/uint32
        minimum: 3
        maximum: 255

      cirrus,hd-rm:
        description:
          Class H/G headroom. Defaults to 0 when the sub-node is present.
        $ref: /schemas/types.yaml#/definitions/uint32
        minimum: 0
        maximum: 0x7f

      cirrus,ldo-thld:
        description:
          Configures the signal threshold at which the PWM output stage enters
          LDO operation. Starts as a default value of 50mV for a value of 1
          and increases with a step size of 50mV to a maximum of 750mV (value
          of 0xF).
        $ref: /schemas/types.yaml#/definitions/uint32
        minimum: 1
        maximum: 0xf

      cirrus,ldo-path-disable:
        description:
          1 = the H/G algorithm uses the max detection path, 0 = the LDO
          detection path is used.
        $ref: /schemas/types.yaml#/definitions/uint32
        enum: [0, 1]

      cirrus,ldo-entry-delay:
        description:
          The LDO entry delay before the H/G algorithm switches to the LDO
          voltage. This property can be set to values from 0 to 7 for delays
          of 5ms, 10ms, 50ms, 100ms, 200ms, 500ms, 1000ms. The default is
          100ms.
        $ref: /schemas/types.yaml#/definitions/uint32
        minimum: 0
        maximum: 7

      cirrus,vp-hg-auto:
        description: When set, class H/G VPhg automatic updating is enabled.
        type: boolean

      cirrus,vp-hg:
        description:
          Class H/G algorithm VPhg. Controls the H/G algorithm's reference to
          the VP voltage for when to start generating a boosted VBST. The
          reference voltage starts at 3000mV with a value of 0x3 and is
          increased by 100mV per step to a maximum of 5500mV.
        $ref: /schemas/types.yaml#/definitions/uint32
        minimum: 0x3
        maximum: 0x1c

      cirrus,vp-hg-rate:
        description:
          The rate (number of LRCLK periods) at which the VPhg is allowed to
          increase to a higher voltage when using VPhg automatic tracking.
          Values 0 to 3 select rates of 128 periods, 2048 periods, 32768
          periods and 524288 periods. The default is 32768 periods.
        $ref: /schemas/types.yaml#/definitions/uint32
        minimum: 0
        maximum: 3

      cirrus,vp-hg-va:
        description:
          VA calculation reference for automatic VPhg tracking using VPMON.
          This property can be set to values from 0 to 6, starting at 1800mV
          with a step size of 50mV. Default is 1800mV.
        $ref: /schemas/types.yaml#/definitions/uint32
        minimum: 0
        maximum: 6

examples:
  - |
    #include <dt-bindings/gpio/gpio.h>
    #include <dt-bindings/interrupt-controller/irq.h>

    i2c {
        #address-cells = <1>;
        #size-cells = <0>;

        amplifier@40 {
            compatible = "cirrus,cs35l33";
            reg = <0x40>;

            VA-supply = <&ldo5_reg>;
            VP-supply = <&ldo5_reg>;

            interrupt-parent = <&gpio8>;
            interrupts = <3 IRQ_TYPE_LEVEL_LOW>;

            reset-gpios = <&cs47l91 34 GPIO_ACTIVE_HIGH>;

            cirrus,ramp-rate = <0x0>;
            cirrus,boost-ctl = <0x30>;      /* VBST = 8000mV */
            cirrus,boost-ipk = <3600000>;   /* 3600mA */
            cirrus,imon-adc-scale = <0>;    /* Bits 15 down to 0 */

            cirrus,hg-algo {
                cirrus,mem-depth = <0x3>;
                cirrus,release-rate = <0x3>;
                cirrus,ldo-thld = <0x1>;
                cirrus,ldo-entry-delay = <0x4>;
                cirrus,vp-hg-auto;
                cirrus,vp-hg = <0xf>;
                cirrus,vp-hg-rate = <0x2>;
                cirrus,vp-hg-va = <0x0>;
            };
        };
    };
```

## Documentation/devicetree/bindings/sound/cirrus,cs42l67.yaml
```yaml
# SPDX-License-Identifier: (GPL-2.0-only OR BSD-2-Clause)
%YAML 1.2
---
$id: http://devicetree.org/schemas/sound/cirrus,cs42l67.yaml#
$schema: http://devicetree.org/meta-schemas/core.yaml#

title: Cirrus Logic CS42L67 audio codec

maintainers:
  - ITSMEFRTRUST <215584995+ITSMEFRTRUST@users.noreply.github.com>

description: |
  Headset, microphone and receiver codec on SPI, found in the Apple iPhone 6.
  It has analog microphone inputs AIN1-AIN7 with MICBIAS outputs, a headset
  microphone input, and serial ports ASP, XSP and VSP. Only the XSP port
  (TDM, the codec is clock consumer) is described here.

allOf:
  - $ref: dai-common.yaml#
  - $ref: /schemas/spi/spi-peripheral-props.yaml#

properties:
  compatible:
    const: cirrus,cs42l67

  reg:
    maxItems: 1

  spi-max-frequency:
    maximum: 12000000

  interrupts:
    maxItems: 1

  clocks:
    maxItems: 1
    description: 12 MHz MCLK

  clock-names:
    const: mclk

  cirrus,xsp-tx-slot:
    $ref: /schemas/types.yaml#/definitions/uint32
    maximum: 15
    default: 4
    description: TDM slot of XSP TX (capture) channel 1; further channels follow.

  cirrus,xsp-rx-slot:
    $ref: /schemas/types.yaml#/definitions/uint32
    maximum: 15
    default: 0
    description: TDM slot that XSP RX (playback) channel 1 takes its data from.

  '#sound-dai-cells':
    const: 0

required:
  - compatible
  - reg
  - '#sound-dai-cells'

unevaluatedProperties: false

examples:
  - |
    #include <dt-bindings/gpio/gpio.h>
    #include <dt-bindings/interrupt-controller/irq.h>
    spi {
        #address-cells = <1>;
        #size-cells = <0>;

        codec@0 {
            compatible = "cirrus,cs42l67";
            reg = <0>;
            spi-max-frequency = <1000000>;
            interrupts-extended = <&pinctrl 127 IRQ_TYPE_LEVEL_LOW>;
            clocks = <&mca2 0>;
            clock-names = "mclk";
            #sound-dai-cells = <0>;
        };
    };
```

## drivers/gpu/drm/adp/Kconfig
```kconfig
# SPDX-License-Identifier: GPL-2.0-only OR MIT
config DRM_ADP
	tristate "DRM Support for pre-DCP Apple display controllers"
	depends on DRM && OF && ARM64
	depends on ARCH_APPLE || COMPILE_TEST
	select DRM_KMS_HELPER
	select DRM_BRIDGE_CONNECTOR
	select DRM_DISPLAY_HELPER
	select DRM_KMS_DMA_HELPER
	select DRM_GEM_DMA_HELPER
	select DRM_PANEL_BRIDGE
	select VIDEOMODE_HELPERS
	select DRM_MIPI_DSI
	help
	  Chose this option if you have an Apple Arm laptop with a touchbar.

	  If M is selected, this module will be called adpdrm.

config DRM_ADP_T7000
	tristate "DRM Support for the Apple A8 (T7000) display pipe"
	depends on DRM && OF && ARM64
	depends on ARCH_APPLE || COMPILE_TEST
	select DRM_KMS_HELPER
	select GENERIC_ALLOCATOR
	help
	  Choose this option for the internal display of Apple A8 devices
	  (iPhone 6, iPad mini 4, iPod touch 6). The driver takes over the
	  display pipe that iBoot set up and scans out buffers from the boot
	  framebuffer carveout.

	  If M is selected, this module will be called adp-t7000.
```

## drivers/gpu/drm/apple-g4p/Kconfig
```kconfig
# SPDX-License-Identifier: GPL-2.0-only OR MIT
config DRM_APPLE_G4P
	tristate "Apple A8 GPU (G4P) power layer and core ID (bring-up)"
	depends on ARCH_APPLE || COMPILE_TEST
	depends on OF && PM
	help
	  Bring-up driver for the PowerVR Rogue based GPU of the Apple A8 (T7000, iPhone 6). It binds without
	  touching the hardware and powers the GPU up only on request through debugfs (module parameter
	  experimental=1). Not a graphics driver yet.
```

## drivers/media/platform/apple/Kconfig
```kconfig
# SPDX-License-Identifier: GPL-2.0-only

comment "Apple media platform drivers"

config VIDEO_APPLE_ISP_T7000
	tristate "Apple A8 (T7000) ISP bring-up test driver"
	depends on ARCH_APPLE || COMPILE_TEST
	depends on OF && ARM64
	help
	  Standalone bring-up/test module for the camera ISP of the Apple
	  A8 (T7000, iPhone 6). It powers the ISP through direct PMGR
	  writes, programs the ISP DART itself, loads apple/isp-t7000.bin
	  and boots the ISP firmware stage by stage (module parameter
	  "stage"). No V4L2 interface yet.

	  To compile this driver as a module, choose M here: the module
	  will be called apple-isp.
```

## sound/soc/apple/Kconfig
```kconfig
# SPDX-License-Identifier: GPL-2.0-only
menu "Apple"

config SND_SOC_APPLE_MCA
	tristate "Apple Silicon MCA driver"
	depends on ARCH_APPLE || COMPILE_TEST
	select SND_DMAENGINE_PCM
	help
	  This option enables an ASoC platform driver for MCA peripherals found
	  on Apple Silicon SoCs.

config SND_SOC_APPLE_MCA_T7000
	tristate "Apple A8 (t7000) MCA driver"
	depends on ARCH_APPLE || COMPILE_TEST
	depends on COMMON_CLK
	help
	  This option enables an ASoC driver for the version 1 MCA found on
	  the Apple A8 SoC (iPhone 6). Playback is fed by the CPU (no DMA).

endmenu
```
