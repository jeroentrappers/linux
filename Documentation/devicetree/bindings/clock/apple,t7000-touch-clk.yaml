## Documentation/devicetree/bindings/clock/apple,t7000-touch-clk.yaml
```yaml
# SPDX-License-Identifier: (GPL-2.0-only OR BSD-2-Clause)
%YAML 1.2
---
$id: http://devicetree.org/schemas/clock/apple,t7000-touch-clk.yaml#
$schema: http://devicetree.org/meta-schemas/core.yaml#

title: Apple A8 PMGR touch clock

maintainers:
  - ITSMEFRTRUST <215584995+ITSMEFRTRUST@users.noreply.github.com>

description:
  The PMGR of the Apple A8 (t7000) has a TOUCH_CTL register that gates and
  divides the reference clock, which is used as the 32.768 kHz clock of the
  multi-touch controller. This node describes that register as a clock and
  is a child of the PMGR syscon node.

properties:
  compatible:
    const: apple,t7000-touch-clk

  reg:
    maxItems: 1
    description:
      Offset of the TOUCH_CTL register in the parent PMGR syscon.

  clocks:
    maxItems: 1
    description: 24 MHz reference clock.

  '#clock-cells':
    const: 0

required:
  - compatible
  - reg
  - clocks
  - '#clock-cells'

additionalProperties: false

examples:
  - |
    soc {
        #address-cells = <2>;
        #size-cells = <2>;

        power-management@20e000000 {
            compatible = "apple,t7000-pmgr", "apple,pmgr", "syscon", "simple-mfd";
            #address-cells = <1>;
            #size-cells = <1>;
            reg = <0x2 0x0e000000 0x0 0x24000>;

            clock-controller@1e000 {
                compatible = "apple,t7000-touch-clk";
                reg = <0x1e000 0x4>;
                clocks = <&clkref>;
                #clock-cells = <0>;
            };
        };
    };
```

## Documentation/devicetree/bindings/gpio/apple,adi-pmic-gpio.yaml
```yaml
# SPDX-License-Identifier: (GPL-2.0-only OR BSD-2-Clause)
%YAML 1.2
---
$id: http://devicetree.org/schemas/gpio/apple,adi-pmic-gpio.yaml#
$schema: http://devicetree.org/meta-schemas/core.yaml#

title: Apple PMIC GPIO controller

maintainers:
  - ITSMEFRTRUST <215584995+ITSMEFRTRUST@users.noreply.github.com>

description:
  The general purpose pins of an Apple PMIC (see ../mfd/apple,pmic.yaml).
  Each pin has its own config register; on the iPhone 6 they switch the
  power of the Wi-Fi/Bluetooth chip.

properties:
  compatible:
    enum:
      - apple,adi-pmic-gpio

  reg:
    maxItems: 1
    description:
      Address and size of the block of per-pin config registers.

  gpio-controller: true

  "#gpio-cells":
    const: 2

  gpio-line-names:
    minItems: 1
    maxItems: 21

  gpio-reserved-ranges: true

required:
  - compatible
  - reg
  - gpio-controller
  - "#gpio-cells"

additionalProperties: false

examples:
  - |
    i2c {
        #address-cells = <1>;
        #size-cells = <0>;

        pmic@74 {
            compatible = "apple,adi-pmic", "apple,i2c-pmic";
            reg = <0x74>;
            #address-cells = <1>;
            #size-cells = <1>;

            gpio@400 {
                compatible = "apple,adi-pmic-gpio";
                reg = <0x400 0x2a>;
                gpio-controller;
                #gpio-cells = <2>;
            };
        };
    };
```

## Documentation/devicetree/bindings/input/touchscreen/apple,z2-multitouch.yaml
```yaml
# SPDX-License-Identifier: (GPL-2.0 OR BSD-2-Clause)
%YAML 1.2
---
$id: http://devicetree.org/schemas/input/touchscreen/apple,z2-multitouch.yaml#
$schema: http://devicetree.org/meta-schemas/core.yaml#

title: Apple touchscreens attached using the Z2 protocol

maintainers:
  - Sasha Finkelstein <k@chaosmail.tech>

description: A series of touschscreen controllers used in Apple products

allOf:
  - $ref: touchscreen.yaml#
  - $ref: /schemas/spi/spi-peripheral-props.yaml#

properties:
  compatible:
    enum:
      - apple,j293-touchbar
      - apple,j493-touchbar
      - apple,n61-touchscreen

  interrupts:
    maxItems: 1

  reset-gpios:
    maxItems: 1

  firmware-name:
    maxItems: 1

  apple,z2-cal-blob:
    $ref: /schemas/types.yaml#/definitions/uint8-array
    maxItems: 4096
    description:
      Calibration blob supplied by the bootloader

  apple,z2-prox-cal-blob:
    $ref: /schemas/types.yaml#/definitions/uint8-array
    maxItems: 4096
    description:
      Proximity sensor calibration blob supplied by the bootloader

  vdd-supply:
    description: Digital supply

  vdd-ana-supply:
    description: Analog supply

  clocks:
    maxItems: 1
    description: 32 kHz reference clock

required:
  - compatible
  - interrupts
  - reset-gpios
  - firmware-name
  - touchscreen-size-x
  - touchscreen-size-y

if:
  not:
    properties:
      compatible:
        contains:
          const: apple,n61-touchscreen
then:
  properties:
    apple,z2-prox-cal-blob: false
    vdd-supply: false
    vdd-ana-supply: false
    clocks: false

unevaluatedProperties: false

examples:
  - |
    #include <dt-bindings/gpio/gpio.h>
    #include <dt-bindings/interrupt-controller/irq.h>

    spi {
        #address-cells = <1>;
        #size-cells = <0>;

        touchscreen@0 {
            compatible = "apple,j293-touchbar";
            reg = <0>;
            spi-max-frequency = <11500000>;
            reset-gpios = <&pinctrl_ap 139 GPIO_ACTIVE_LOW>;
            interrupts-extended = <&pinctrl_ap 194 IRQ_TYPE_EDGE_FALLING>;
            firmware-name = "apple/dfrmtfw-j293.bin";
            touchscreen-size-x = <23045>;
            touchscreen-size-y = <640>;
        };
    };

...
```

## Documentation/devicetree/bindings/interrupt-controller/apple,adi-pmic-irq.yaml
```yaml
# SPDX-License-Identifier: (GPL-2.0-only OR BSD-2-Clause)
%YAML 1.2
---
$id: http://devicetree.org/schemas/interrupt-controller/apple,adi-pmic-irq.yaml#
$schema: http://devicetree.org/meta-schemas/core.yaml#

title: Apple PMIC interrupt controller

maintainers:
  - ITSMEFRTRUST <215584995+ITSMEFRTRUST@users.noreply.github.com>

description:
  The event interrupts of an Apple PMIC (see ../mfd/apple,pmic.yaml). The
  PMIC latches up to 104 events in 13 event registers, each with a mask bit,
  and signals them on one interrupt line to the SoC. Event n is bit n % 8 of
  event register n / 8. On the D2186 of the iPhone 6, event 3 is VBUS
  detect, events 24 to 44 are PMIC GPIO 0 to 20 and event 88 is the RTC
  alarm.

properties:
  compatible:
    enum:
      - apple,adi-pmic-irq

  reg:
    maxItems: 1
    description:
      The event, status and mask registers, in this order, 16 registers
      apart.

  interrupts:
    maxItems: 1

  interrupt-controller: true

  "#interrupt-cells":
    const: 2
    description:
      The first cell is the event number, the second the trigger type. The
      PMIC latches every event on its own, so the type is not used.

required:
  - compatible
  - reg
  - interrupts
  - interrupt-controller
  - "#interrupt-cells"

additionalProperties: false

examples:
  - |
    #include <dt-bindings/interrupt-controller/irq.h>

    i2c {
        #address-cells = <1>;
        #size-cells = <0>;

        pmic@74 {
            compatible = "apple,adi-pmic", "apple,i2c-pmic";
            reg = <0x74>;
            #address-cells = <1>;
            #size-cells = <1>;

            interrupt-controller@50 {
                compatible = "apple,adi-pmic-irq";
                reg = <0x50 0x2d>;
                interrupts-extended = <&pinctrl 106 IRQ_TYPE_LEVEL_LOW>;
                interrupt-controller;
                #interrupt-cells = <2>;
            };
        };
    };
```

## Documentation/devicetree/bindings/power/supply/apple,t7000-swi-gauge.yaml
```yaml
# SPDX-License-Identifier: (GPL-2.0-only OR BSD-2-Clause)
%YAML 1.2
---
$id: http://devicetree.org/schemas/power/supply/apple,t7000-swi-gauge.yaml#
$schema: http://devicetree.org/meta-schemas/core.yaml#

title: Apple SWI battery gauge

maintainers:
  - ITSMEFRTRUST <215584995+ITSMEFRTRUST@users.noreply.github.com>

description:
  The battery of the iPhone 6 has a TI bq27540 gas gauge that speaks HDQ
  over a single wire. A SoC UART drives the wire, one UART frame per HDQ
  bit. The wire goes through the SN2400 charger, which has to hand it to
  the SoC before each access. The node describes the UART used this way.

allOf:
  - $ref: power-supply.yaml#

properties:
  compatible:
    const: apple,t7000-swi-gauge

  reg:
    maxItems: 1

  power-domains:
    maxItems: 1

  apple,swi-master:
    $ref: /schemas/types.yaml#/definitions/phandle
    description: The charger that hands the wire over.

required:
  - compatible
  - reg
  - apple,swi-master

unevaluatedProperties: false

examples:
  - |
    battery-gauge@a0d4000 {
        compatible = "apple,t7000-swi-gauge";
        reg = <0xa0d4000 0x4000>;
        apple,swi-master = <&charger>;
        power-supplies = <&charger>;
    };
```

## Documentation/devicetree/bindings/power/supply/ti,sn2400.yaml
```yaml
# SPDX-License-Identifier: (GPL-2.0-only OR BSD-2-Clause)
%YAML 1.2
---
$id: http://devicetree.org/schemas/power/supply/ti,sn2400.yaml#
$schema: http://devicetree.org/meta-schemas/core.yaml#

title: TI SN2400 USB charger

maintainers:
  - Jeroen Trappers <jeroen.trappers@gmail.com>

description:
  The SN2400 is a single-cell Li-ion battery charger with a USB input,
  made by TI for Apple and used in the iPhone 6. It is controlled over
  I2C; it limits the current drawn from VBUS, sets the battery charge
  current and has an ADC for the input voltage and current. Its
  interrupt output signals events such as cable plug and unplug. The
  battery gauge's single-wire (HDQ) bus is routed through the charger,
  which hands it to the host on request.

allOf:
  - $ref: power-supply.yaml#

properties:
  compatible:
    const: ti,sn2400

  reg:
    maxItems: 1

  interrupts:
    maxItems: 1

  wakeup-source: true

  input-current-limit-microamp:
    description:
      Current limit for the USB input, applied at probe time.
    minimum: 90000
    maximum: 2000000
    default: 500000

  constant-charge-current-max-microamp:
    description:
      Battery charge current, applied at probe time.
    maximum: 2550000
    default: 1000000

required:
  - compatible
  - reg

unevaluatedProperties: false

examples:
  - |
    #include <dt-bindings/interrupt-controller/irq.h>

    i2c {
        #address-cells = <1>;
        #size-cells = <0>;

        charger@75 {
            compatible = "ti,sn2400";
            reg = <0x75>;
            interrupt-parent = <&pmic>;
            interrupts = <24 IRQ_TYPE_LEVEL_LOW>;
            wakeup-source;
            input-current-limit-microamp = <500000>;
            constant-charge-current-max-microamp = <1000000>;
        };
    };
```

## Documentation/devicetree/bindings/regulator/apple,adi-pmic-ldo.yaml
```yaml
# SPDX-License-Identifier: (GPL-2.0-only OR BSD-2-Clause)
%YAML 1.2
---
$id: http://devicetree.org/schemas/regulator/apple,adi-pmic-ldo.yaml#
$schema: http://devicetree.org/meta-schemas/core.yaml#

title: Apple PMIC enable-only LDO switch

maintainers:
  - ITSMEFRTRUST <215584995+ITSMEFRTRUST@users.noreply.github.com>

description:
  An LDO of an Apple PMIC (see ../mfd/apple,pmic.yaml) that is only switched
  on and off. The voltage is left as the bootloader configured it.

properties:
  compatible:
    enum:
      - apple,adi-pmic-ldo4
      - apple,adi-pmic-ldo15
      - apple,adi-pmic-ldo16
      - apple,adi-pmic-ldo18

  reg:
    maxItems: 1
    description:
      Address of the register that holds the enable bit of the LDO. The
      register size is 1.

required:
  - compatible
  - reg

allOf:
  - $ref: regulator.yaml#

unevaluatedProperties: false

examples:
  - |
    i2c {
        #address-cells = <1>;
        #size-cells = <0>;

        pmic@74 {
            compatible = "apple,adi-pmic", "apple,i2c-pmic";
            reg = <0x74>;
            #address-cells = <1>;
            #size-cells = <1>;

            ldo15@85 {
                compatible = "apple,adi-pmic-ldo15";
                reg = <0x85 0x1>;
                regulator-name = "ldo15";
            };
        };
    };
```

## Documentation/devicetree/bindings/regulator/apple,chestnut.yaml
```yaml
# SPDX-License-Identifier: (GPL-2.0-only OR BSD-2-Clause)
%YAML 1.2
---
$id: http://devicetree.org/schemas/regulator/apple,chestnut.yaml#
$schema: http://devicetree.org/meta-schemas/core.yaml#

title: Apple Chestnut display PMU

maintainers:
  - ITSMEFRTRUST <215584995+ITSMEFRTRUST@users.noreply.github.com>

description:
  The Chestnut display PMU is an I2C attached PMU found in Apple iPhones with
  A8 and similar SoCs. It provides the LCD supplies, which are set up by the
  bootloader and not described here, and the analog supply of the touch
  controller. The latter is a switch that has no voltage control.

properties:
  compatible:
    const: apple,chestnut

  reg:
    maxItems: 1

  regulators:
    type: object
    description: Regulators provided by the PMU.

    properties:
      ldo2:
        type: object
        $ref: regulator.yaml#
        unevaluatedProperties: false
        description: Touch controller analog supply switch.

    additionalProperties: false

required:
  - compatible
  - reg

additionalProperties: false

examples:
  - |
    i2c {
        #address-cells = <1>;
        #size-cells = <0>;

        display-pmu@27 {
            compatible = "apple,chestnut";
            reg = <0x27>;

            regulators {
                chestnut_ldo2: ldo2 {
                    regulator-name = "chestnut-ldo2";
                };
            };
        };
    };
```
