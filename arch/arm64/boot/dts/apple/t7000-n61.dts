// SPDX-License-Identifier: GPL-2.0+ OR MIT
/*
 * Apple iPhone 6, N61, iPhone7,2 (A1549/A1586/A1589)
 * Copyright (c) 2022, Konrad Dybcio <konradybcio@kernel.org>
 */

/dts-v1/;

#include "t7000-6.dtsi"

/ {
	compatible = "apple,n61", "apple,t7000", "apple,arm-platform";
	model = "Apple iPhone 6";
};

&i2c1 {
	status = "okay";

	charger@75 {
		compatible = "ti,sn2400";
		reg = <0x75>;
		input-current-limit-microamp = <500000>;
		constant-charge-current-max-microamp = <1000000>;
	};
};
